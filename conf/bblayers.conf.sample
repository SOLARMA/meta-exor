## conf/bblayers.conf.sample
```bitbake
# LAYER_CONF_VERSION is increased each time build/conf/bblayers.conf
# changes incompatibly
POKY_BBLAYERS_CONF_VERSION = "2"

BBPATH = "${TOPDIR}"
SRCDIR = "${TOPDIR}/../git"

BBFILES = ""

BBLAYERS += " \
  ${SRCDIR}/meta-exor \
  ${SRCDIR}/yocto-poky/meta \
  ${SRCDIR}/yocto-poky/meta-poky \
  ${SRCDIR}/yocto-poky/meta-yocto-bsp \
  ${SRCDIR}/yocto-meta-openembedded/meta-gnome \
  ${SRCDIR}/yocto-meta-openembedded/meta-oe \
  ${SRCDIR}/yocto-meta-openembedded/meta-python \
  ${SRCDIR}/yocto-meta-openembedded/meta-networking \
  ${SRCDIR}/yocto-meta-openembedded/meta-multimedia \
  ${SRCDIR}/meta-browser \
  ${SRCDIR}/meta-qt5 \
  ${SRCDIR}/meta-freescale \
"

BBLAYERS_NON_REMOVABLE ?= " \
  ${SRCDIR}/yocto-poky/meta \
  ${SRCDIR}/yocto-poky/meta-poky \
  "
```

## conf/distro/exorintos.conf
```bitbake
require conf/distro/poky.conf

DISTRO = "exorintos"

DISTRO_NAME = "ExorintOS"

#pyro Based
DISTRO_VERSION = "3.0"

DISTRO_CODENAME = "exorintos"

DISTRO_FEATURES_append = " pam"

DISTRO_FEATURES_remove = "wayland"
```

## conf/layer.conf
```bitbake
# We have a conf and classes directory, append to BBPATH
BBPATH .= ":${LAYERDIR}"

# We have a recipes directory, add to BBFILES
BBFILES += "${LAYERDIR}/recipes*/*/*.bb ${LAYERDIR}/recipes*/*/*.bbappend"

BBFILE_COLLECTIONS += "us02"
BBFILE_PATTERN_us02 := "^${LAYERDIR}/"
BBFILE_PRIORITY_us02 = "9"
```

## conf/machine/ns01-kit.conf
```bitbake
#@TYPE: Machine
#@NAME: Exor uSOM
#@DESCRIPTION: Machine configuration for the Exor uSOM03

require conf/machine/include/imx-base.inc
require conf/machine/include/tune-cortexa7.inc

require exor.inc

SOC_FAMILY = "mx6ul"

# Make sure hard fp is enabled (-mfloat-abi=hard GCC option)
DEFAULTTUNE = "cortexa7hf-neon"

SERIAL_CONSOLE = "115200 ttymxc0"

PREFERRED_PROVIDER_virtual/kernel = "linux-fslc-mx6-rt"
PREFERRED_VERSION_linux-fslc-mx6-rt = "4.1-2.0.x"

#PREFERRED_PROVIDER_virtual/libgl = "mesa"
#PREFERRED_PROVIDER_virtual/libgles1 = "mesa"
#PREFERRED_PROVIDER_virtual/libgles2 = "mesa"


PREFERRED_PROVIDER_virtual/bootloader = "bootloader"
UBOOT_MACHINE = "ns01-imx6ul_config"

KERNEL_DEVICETREE = "ns01-evk.dtb"

MACHINEOVERRIDES =. "nsom01:"
```

## conf/machine/us01-kit.conf
```bitbake
#@TYPE: Machine
#@NAME: Exor uSOM
#@DESCRIPTION: Machine configuration for the Exor uSOM01

require conf/machine/include/tune-cortexa8.inc

SOC_FAMILY = "ti33x"
require conf/machine/include/soc-family.inc

# Make sure hard fp is enabled (-mfloat-abi=hard GCC option)
DEFAULTTUNE = "cortexa8hf-neon"

IMAGE_FSTYPES = "tar.gz"

MKUBIFS_ARGS = "-F -m 2048 -e 126976 -c 4095"
UBINIZE_ARGS = "-m 2048 -p 128KiB -s 512 -O 2048"
UBI_VOLNAME = "rootfs"

SERIAL_CONSOLE = "115200 ttyO0"

PREFERRED_PROVIDER_virtual/kernel = "linux-ti-staging"
PREFERRED_VERSION_linux-ti-staging = "4.1%"

UBOOT_MACHINE = "am335x_usom_config"
KERNEL_DEVICETREE = "usom_eco.dtb"

# Uncomment these lines to enable hardware acceleration on a wayland image
#PREFERRED_PROVIDER_virtual/egl = "ti-sgx-ddk-um"
#PREFERRED_PROVIDER_virtual/libgles1 = "ti-sgx-ddk-um"
#PREFERRED_PROVIDER_virtual/libgles2 = "ti-sgx-ddk-um"
#PREFERRED_PROVIDER_virtual/libgl = "mesa-gl"
#PREFERRED_PROVIDER_virtual/mesa = "mesa-gl"
#PREFERRED_PROVIDER_libgbm = "libgbm"

# List common SoC features, may need to add touchscreen for specific machines
MACHINE_FEATURES = "vfat touchscreen ethernet sgx"

GCCVERSION = "4.9%"

MACHINEOVERRIDES =. "usom01:"
```

## conf/machine/us03-kit.conf
```bitbake
#@TYPE: Machine
#@NAME: Exor uSOM
#@DESCRIPTION: Machine configuration for the Exor uSOM03

require exor.inc

SOC_FAMILY = "mx6:mx6q:"

# Make sure hard fp is enabled (-mfloat-abi=hard GCC option)
DEFAULTTUNE = "cortexa9hf-neon"

SERIAL_CONSOLE = "115200 ttymxc0"

PREFERRED_PROVIDER_virtual/kernel = "linux-imx-rt"
PREFERRED_VERSION_linux-imx-rt = "3.14.28"

PREFERRED_PROVIDER_virtual/bootloader = "bootloader"
UBOOT_MACHINE = "mx6q_usom_config"

PREFERRED_PROVIDER_virtual/wayland-egl = "imx-gpu-viv"
PREFERRED_VERSION_imx-gpu-viv = "5.0.11.p4.4-hfp"
PREFERRED_VERSION_xf86-video-imxfb-vivante = "5.0.11.p4.4"
PREFERRED_VERSION_xf86-video-imxfb = "11.09.01"

ACCEPT_FSL_EULA = "1"
MACHINE_USES_VIVANTE_KERNEL_DRIVER_MODULE = "1"
MACHINE_HAS_VIVANTE_KERNEL_DRIVER_SUPPORT = "1"

KERNEL_DEVICETREE = "usom_evkitq.dtb"
KERNEL_MACHINE = "imx6usom"

MACHINEOVERRIDES =. "usom03:mx6:mx6dl:"

require conf/machine/include/imx-base.inc
require conf/machine/include/tune-cortexa9.inc
```

## conf/machine/usom01.conf
```bitbake
#@TYPE: Machine
#@NAME: Exor uSOM
#@DESCRIPTION: Machine configuration for the Exor uSOM01

require conf/machine/include/tune-cortexa9.inc

# Make sure hard fp is enabled (-mfloat-abi=hard GCC option)
DEFAULTTUNE = "cortexa9hf-neon"

IMAGE_FSTYPES += "tar.gz"

MKUBIFS_ARGS = "-F -m 2048 -e 126976 -c 4095"
UBINIZE_ARGS = "-m 2048 -p 128KiB -s 512 -O 2048"
UBI_VOLNAME = "rootfs"

SERIAL_CONSOLE = "115200 ttyO0"

PREFERRED_PROVIDER_virtual/kernel = "linux"

UBOOT_MACHINE = "am335x_usom_config"
KERNEL_MACHINE = "am33xxusom"

GCCVERSION = "4.9%"
```
